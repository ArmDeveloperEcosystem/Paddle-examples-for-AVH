/*
 * Licensed to the Apache Software Foundation (ASF) under one
 * or more contributor license agreements.  See the NOTICE file
 * distributed with this work for additional information
 * regarding copyright ownership.  The ASF licenses this file
 * to you under the Apache License, Version 2.0 (the
 * "License"); you may not use this file except in compliance
 * with the License.  You may obtain a copy of the License at
 *
 *   http://www.apache.org/licenses/LICENSE-2.0
 *
 * Unless required by applicable law or agreed to in writing,
 * software distributed under the License is distributed on an
 * "AS IS" BASIS, WITHOUT WARRANTIES OR CONDITIONS OF ANY
 * KIND, either express or implied.  See the License for the
 * specific language governing permissions and limitations
 * under the License.
 */

#include <stdio.h>
#include <tvm_runtime.h>
#include <tvmgen_cls.h>
#include "uart.h"

// Header files generated by convert_image.py
#include "inputs.h"
#include "outputs.h"


int main(int argc, char** argv) {
  uart_init();
  printf("Starting cls inference\n");
  struct tvmgen_cls_outputs cls_outputs = {
      .output = output,
  };
  struct tvmgen_cls_inputs cls_inputs = {
      .x = input,
  };

  tvmgen_cls_run(&cls_inputs, &cls_outputs);

  // post process
  int index = 0;
  for(int i = 0; i < output_len;i++){
    if(output[i] > output[index]){
        index = i;
    }
  }
  printf("%d,%f\n", index, output[index]);

  // The FVP will shut down when it clseives "EXITTHESIM" on the UART
  printf("EXITTHESIM\n");
  while (1 == 1)
    ;
  return 0;
}